## cat_food_machine/sdkconfig.defaults
```kconfig
# Set target chip
CONFIG_IDF_TARGET="esp32s3"

# TinyUSB Configuration
CONFIG_TINYUSB_CDC_ENABLED=y

# LVGL Configuration
CONFIG_LV_COLOR_16_SWAP=y

CONFIG_LV_FONT_MONTSERRAT_10=y
CONFIG_LV_FONT_MONTSERRAT_12=y
CONFIG_LV_FONT_MONTSERRAT_14=y
CONFIG_LV_FONT_MONTSERRAT_16=y
CONFIG_LV_FONT_MONTSERRAT_18=y
CONFIG_LV_FONT_MONTSERRAT_20=y
CONFIG_LV_FONT_MONTSERRAT_22=y
CONFIG_LV_FONT_MONTSERRAT_24=y
CONFIG_LV_FONT_MONTSERRAT_48=y

# All debug output goes to UART0 via uart_write_bytes
CONFIG_ESP_CONSOLE_SECONDARY_NONE=y

# Disable Task WDT
# CONFIG_ESP_TASK_WDT_EN is not set
# CONFIG_ESP_TASK_WDT_INIT is not set
# CONFIG_TASK_WDT is not set
```

## example/car/sdkconfig.defaults
```kconfig
CONFIG_PARTITION_TABLE_CUSTOM=y
CONFIG_PARTITION_TABLE_CUSTOM_FILENAME="partitions.csv"
CONFIG_PARTITION_TABLE_FILENAME="partitions.csv"
CONFIG_ESP_CONSOLE_SECONDARY_NONE=y
CONFIG_ESPTOOLPY_FLASHSIZE_8MB=y
CONFIG_FREERTOS_USE_TRACE_FACILITY=y
CONFIG_FREERTOS_GENERATE_RUN_TIME_STATS=y
CONFIG_FREERTOS_HZ=1000

CONFIG_LV_COLOR_16_SWAP=y

CONFIG_LV_FONT_MONTSERRAT_10=y
CONFIG_LV_FONT_MONTSERRAT_12=y
CONFIG_LV_FONT_MONTSERRAT_14=y
CONFIG_LV_FONT_MONTSERRAT_16=y
CONFIG_LV_FONT_MONTSERRAT_18=y
CONFIG_LV_FONT_MONTSERRAT_20=y
CONFIG_LV_FONT_MONTSERRAT_22=y
CONFIG_LV_FONT_MONTSERRAT_24=y
CONFIG_LV_FONT_MONTSERRAT_48=y

# All debug output goes to UART0 via uart_write_bytes.
CONFIG_TINYUSB_CDC_ENABLED=y

# Disable Task WDT entirely — it causes "task not found" spam during boot,
# and no user task relies on it for fault detection.
# CONFIG_ESP_TASK_WDT_EN is not set
# CONFIG_ESP_TASK_WDT_INIT is not set
# CONFIG_TASK_WDT is not set
```

## example/lsm6dsm_example/sdkconfig.defaults
```kconfig
# =====================
# LSM6DSM Example defaults
# =====================

# Enable TinyUSB stack for CDC-ACM (USB virtual serial port)
CONFIG_TINYUSB=y
CONFIG_TINYUSB_CDC_ENABLED=y

# Disable UART console output since we use USB CDC
# (ESP logs will be redirected to USB CDC via esp_log_set_vprintf)
CONFIG_ESP_CONSOLE_NONE=y
# If the above is not available as single-select, use UART default anyway:
# CONFIG_ESP_CONSOLE_UART_DEFAULT=y
# CONFIG_ESP_CONSOLE_USB_CDC=y  # alternative for chips that support native USB CDC

# Compiler optimizations
CONFIG_COMPILER_OPTIMIZATION_DEFAULT=y
```
